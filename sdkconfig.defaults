## sdkconfig.defaults
```kconfig
CONFIG_IDF_TARGET="esp32c6"

# libsodium
CONFIG_LIBSODIUM_USE_MBEDTLS_SHA=y

# NIMBLE (BLE for commissioning)
CONFIG_BT_ENABLED=y
CONFIG_BT_NIMBLE_ENABLED=y
CONFIG_BT_NIMBLE_EXT_ADV=n
CONFIG_BT_NIMBLE_HCI_EVT_BUF_SIZE=70
CONFIG_BT_NIMBLE_ENABLE_CONN_REATTEMPT=n
CONFIG_USE_BLE_ONLY_FOR_COMMISSIONING=n

# FreeRTOS should use legacy API
CONFIG_FREERTOS_ENABLE_BACKWARD_COMPATIBILITY=y

# Default to 921600 baud when flashing and monitoring device
CONFIG_ESPTOOLPY_BAUD_921600B=y
CONFIG_ESPTOOLPY_BAUD=921600
CONFIG_ESPTOOLPY_COMPRESSED=y
CONFIG_ESPTOOLPY_MONITOR_BAUD_115200B=y
CONFIG_ESPTOOLPY_MONITOR_BAUD=115200
CONFIG_ESPTOOLPY_FLASHSIZE_4MB=y

# OpenThread (Matter over Thread)
CONFIG_IEEE802154_ENABLED=y
CONFIG_OPENTHREAD_ENABLED=y
CONFIG_OPENTHREAD_SRP_CLIENT=y
CONFIG_OPENTHREAD_DNS_CLIENT=y
CONFIG_OPENTHREAD_LOG_LEVEL_DYNAMIC=n
CONFIG_OPENTHREAD_LOG_LEVEL_NOTE=y
CONFIG_OPENTHREAD_CLI=n
CONFIG_OPENTHREAD_JOINER=y
CONFIG_OPENTHREAD_MANUAL_START=n
CONFIG_OPENTHREAD_MTD=y
CONFIG_OPENTHREAD_FTD=n

# Disable WiFi — this is a Thread end device
CONFIG_ESP_WIFI_ENABLED=n
CONFIG_ENABLE_WIFI_STATION=n
CONFIG_ENABLE_WIFI_AP=n
CONFIG_ESP_WIFI_SOFTAP_SUPPORT=n

# Disable lwip ipv6 autoconfig (Thread handles its own addressing)
CONFIG_LWIP_IPV6_AUTOCONFIG=n

# LwIP config for OpenThread
CONFIG_LWIP_IPV6=y
CONFIG_LWIP_IPV6_FORWARD=y
CONFIG_LWIP_IPV6_NUM_ADDRESSES=8
CONFIG_LWIP_MULTICAST_PING=y
CONFIG_LWIP_IPV6_ND=y

# Use a custom partition table
CONFIG_PARTITION_TABLE_CUSTOM=y
CONFIG_PARTITION_TABLE_FILENAME="partitions.csv"
CONFIG_PARTITION_TABLE_OFFSET=0xC000

# Enable chip shell
CONFIG_ENABLE_CHIP_SHELL=y

# MDNS platform (use platform mDNS, not minimal, for Thread)
CONFIG_USE_MINIMAL_MDNS=n
CONFIG_ENABLE_EXTENDED_DISCOVERY=y

# Enable OTA Requestor
CONFIG_ENABLE_OTA_REQUESTOR=y

# Disable DS Peripheral
CONFIG_ESP_SECURE_CERT_DS_PERIPHERAL=n

# Use compact attribute storage mode
CONFIG_ESP_MATTER_NVS_USE_COMPACT_ATTR_STORAGE=y

# Enable HKDF in mbedtls
CONFIG_MBEDTLS_HKDF_C=y

# Button
CONFIG_BUTTON_PERIOD_TIME_MS=20
CONFIG_BUTTON_LONG_PRESS_TIME_MS=5000

# ESP32-C6 DevKit Settings
# Buttons
CONFIG_BSP_BUTTONS_NUM=1
CONFIG_BSP_BUTTON_1_TYPE_GPIO=y
CONFIG_BSP_BUTTON_1_GPIO=0
CONFIG_BSP_BUTTON_1_LEVEL=0
# LEDs
CONFIG_BSP_LEDS_NUM=0

# Diagnostic logs transfer over BDX protocol
CONFIG_CHIP_ENABLE_BDX_LOG_TRANSFER=y

# Core dump to flash
CONFIG_ESP32_ENABLE_COREDUMP_TO_FLASH=y
CONFIG_ESP32_COREDUMP_DATA_FORMAT_ELF=y

# Stack sizes (Swift relies on larger stacks for main/ESP-Matter tasks)
CONFIG_ESP_MAIN_TASK_STACK_SIZE=16384
CONFIG_CHIP_TASK_STACK_SIZE=16384
CONFIG_BT_NIMBLE_HOST_TASK_STACK_SIZE=8192
CONFIG_ESP_TIMER_TASK_STACK_SIZE=8192
CONFIG_ESP_SYSTEM_EVENT_TASK_STACK_SIZE=4096

# Stack overflow detection (canary at end of stack, caught on context switch)
CONFIG_FREERTOS_CHECK_STACKOVERFLOW_CANARY=y

# MbedTLS: DTLS and ECJPAKE required by OpenThread commissioning
CONFIG_MBEDTLS_SSL_PROTO_DTLS=y
CONFIG_MBEDTLS_ECJPAKE_C=y
CONFIG_MBEDTLS_KEY_EXCHANGE_ECJPAKE=y
```

## sdkconfig.defaults.thread
```kconfig
CONFIG_IDF_TARGET="esp32c6"

# --- Network: Thread ---------------------------------------------------
CONFIG_OPENTHREAD_ENABLED=y
CONFIG_OPENTHREAD_MTD=y
CONFIG_OPENTHREAD_FTD=n
CONFIG_OPENTHREAD_SRP_CLIENT=y
CONFIG_OPENTHREAD_DNS_CLIENT=y
CONFIG_OPENTHREAD_JOINER=y
CONFIG_OPENTHREAD_MANUAL_START=n
CONFIG_OPENTHREAD_CLI=n
CONFIG_OPENTHREAD_LOG_LEVEL_DYNAMIC=n
CONFIG_OPENTHREAD_LOG_LEVEL_NOTE=y
CONFIG_IEEE802154_ENABLED=y

CONFIG_ESP_WIFI_ENABLED=n
CONFIG_ENABLE_WIFI_STATION=n
CONFIG_ENABLE_WIFI_AP=n
CONFIG_ESP_WIFI_SOFTAP_SUPPORT=n

# --- LwIP ---------------------------------------------------------------
CONFIG_LWIP_IPV6=y
CONFIG_LWIP_IPV6_AUTOCONFIG=n
CONFIG_LWIP_IPV6_FORWARD=y
CONFIG_LWIP_IPV6_ND=y
CONFIG_LWIP_IPV6_NUM_ADDRESSES=8
CONFIG_LWIP_MULTICAST_PING=y

# --- mDNS (platform mDNS required for Thread) --------------------------
CONFIG_USE_MINIMAL_MDNS=n
CONFIG_ENABLE_EXTENDED_DISCOVERY=y

# --- MbedTLS (DTLS + ECJPAKE required by OpenThread commissioning) -----
CONFIG_MBEDTLS_HKDF_C=y
CONFIG_MBEDTLS_SSL_PROTO_DTLS=y
CONFIG_MBEDTLS_ECJPAKE_C=y
CONFIG_MBEDTLS_KEY_EXCHANGE_ECJPAKE=y

# --- BLE ----------------------------------------------------------------
CONFIG_BT_ENABLED=y
CONFIG_BT_NIMBLE_ENABLED=y
CONFIG_BT_NIMBLE_EXT_ADV=n
CONFIG_BT_NIMBLE_HCI_EVT_BUF_SIZE=70
CONFIG_BT_NIMBLE_ENABLE_CONN_REATTEMPT=n
CONFIG_USE_BLE_ONLY_FOR_COMMISSIONING=n

# --- Matter / CHIP ------------------------------------------------------
CONFIG_ENABLE_CHIP_SHELL=y
CONFIG_ENABLE_OTA_REQUESTOR=y
CONFIG_ESP_MATTER_NVS_USE_COMPACT_ATTR_STORAGE=y
CONFIG_ESP_SECURE_CERT_DS_PERIPHERAL=n
CONFIG_CHIP_ENABLE_BDX_LOG_TRANSFER=y
CONFIG_LIBSODIUM_USE_MBEDTLS_SHA=y

# --- Flash & serial -----------------------------------------------------
CONFIG_ESPTOOLPY_FLASHSIZE_4MB=y
CONFIG_ESPTOOLPY_BAUD_921600B=y
CONFIG_ESPTOOLPY_BAUD=921600
CONFIG_ESPTOOLPY_COMPRESSED=y
CONFIG_ESPTOOLPY_MONITOR_BAUD_115200B=y
CONFIG_ESPTOOLPY_MONITOR_BAUD=115200

# --- Partition table ----------------------------------------------------
CONFIG_PARTITION_TABLE_CUSTOM=y
CONFIG_PARTITION_TABLE_FILENAME="partitions.csv"
CONFIG_PARTITION_TABLE_OFFSET=0xC000

# --- FreeRTOS -----------------------------------------------------------
CONFIG_FREERTOS_ENABLE_BACKWARD_COMPATIBILITY=y
CONFIG_FREERTOS_CHECK_STACKOVERFLOW_CANARY=y

# --- Stack sizes (Embedded Swift needs larger stacks) -------------------
CONFIG_ESP_MAIN_TASK_STACK_SIZE=16384
CONFIG_CHIP_TASK_STACK_SIZE=16384
CONFIG_BT_NIMBLE_HOST_TASK_STACK_SIZE=8192
CONFIG_ESP_TIMER_TASK_STACK_SIZE=8192
CONFIG_ESP_SYSTEM_EVENT_TASK_STACK_SIZE=4096

# --- Board: ESP32-C6 DevKit --------------------------------------------
CONFIG_BSP_BUTTONS_NUM=1
CONFIG_BSP_BUTTON_1_TYPE_GPIO=y
CONFIG_BSP_BUTTON_1_GPIO=0
CONFIG_BSP_BUTTON_1_LEVEL=0
CONFIG_BSP_LEDS_NUM=0
CONFIG_BUTTON_PERIOD_TIME_MS=20
CONFIG_BUTTON_LONG_PRESS_TIME_MS=5000

# --- Debug --------------------------------------------------------------
CONFIG_ESP32_ENABLE_COREDUMP_TO_FLASH=y
CONFIG_ESP32_COREDUMP_DATA_FORMAT_ELF=y
```

## sdkconfig.defaults.wifi
```kconfig
CONFIG_IDF_TARGET="esp32c6"

# --- Network: WiFi ------------------------------------------------------
CONFIG_ENABLE_WIFI_STATION=y
CONFIG_ENABLE_WIFI_AP=n
CONFIG_ESP_WIFI_SOFTAP_SUPPORT=n
CONFIG_DEFAULT_WIFI_SSID="Boy1212  2.4G"
CONFIG_DEFAULT_WIFI_PASSWORD="0620380499"
CONFIG_WIFI_STATION_RECONNECT_INTERVAL=1000
CONFIG_MAX_SCAN_NETWORKS_RESULTS=3000
CONFIG_WIFI_SCAN_COMPLETION_TIMEOUT=10000

# --- LwIP ---------------------------------------------------------------
CONFIG_LWIP_LOCAL_HOSTNAME="IrrigationController"
CONFIG_LWIP_IPV6_AUTOCONFIG=y
CONFIG_LWIP_HOOK_IP6_ROUTE_DEFAULT=y
CONFIG_LWIP_HOOK_ND6_GET_GW_DEFAULT=y
CONFIG_LWIP_IPV6_NUM_ADDRESSES=6

# --- mDNS (minimal mDNS for WiFi) --------------------------------------
CONFIG_USE_MINIMAL_MDNS=y
CONFIG_ENABLE_EXTENDED_DISCOVERY=y

# --- MbedTLS ------------------------------------------------------------
CONFIG_MBEDTLS_HKDF_C=y

# --- BLE ----------------------------------------------------------------
CONFIG_BT_ENABLED=y
CONFIG_BT_NIMBLE_ENABLED=y
CONFIG_BT_NIMBLE_EXT_ADV=n
CONFIG_BT_NIMBLE_HCI_EVT_BUF_SIZE=70
CONFIG_BT_NIMBLE_ENABLE_CONN_REATTEMPT=n
CONFIG_USE_BLE_ONLY_FOR_COMMISSIONING=y

# --- Matter / CHIP ------------------------------------------------------
CONFIG_ENABLE_CHIP_SHELL=y
CONFIG_ENABLE_OTA_REQUESTOR=y
CONFIG_ESP_MATTER_NVS_USE_COMPACT_ATTR_STORAGE=y
CONFIG_ESP_SECURE_CERT_DS_PERIPHERAL=n
CONFIG_CHIP_ENABLE_BDX_LOG_TRANSFER=y
CONFIG_LIBSODIUM_USE_MBEDTLS_SHA=y

# --- Flash & serial -----------------------------------------------------
CONFIG_ESPTOOLPY_FLASHSIZE_4MB=y
CONFIG_ESPTOOLPY_BAUD_921600B=y
CONFIG_ESPTOOLPY_BAUD=921600
CONFIG_ESPTOOLPY_COMPRESSED=y
CONFIG_ESPTOOLPY_MONITOR_BAUD_115200B=y
CONFIG_ESPTOOLPY_MONITOR_BAUD=115200

# --- Partition table ----------------------------------------------------
CONFIG_PARTITION_TABLE_CUSTOM=y
CONFIG_PARTITION_TABLE_FILENAME="partitions.csv"
CONFIG_PARTITION_TABLE_OFFSET=0xC000

# --- FreeRTOS -----------------------------------------------------------
CONFIG_FREERTOS_ENABLE_BACKWARD_COMPATIBILITY=y
CONFIG_FREERTOS_CHECK_STACKOVERFLOW_CANARY=y

# --- Stack sizes (Embedded Swift needs larger stacks) -------------------
CONFIG_ESP_MAIN_TASK_STACK_SIZE=16384
CONFIG_CHIP_TASK_STACK_SIZE=16384
CONFIG_BT_NIMBLE_HOST_TASK_STACK_SIZE=8192
CONFIG_ESP_TIMER_TASK_STACK_SIZE=8192
CONFIG_ESP_SYSTEM_EVENT_TASK_STACK_SIZE=4096

# --- Board: ESP32-C6 DevKit --------------------------------------------
# CONFIG_BSP_BUTTONS_NUM=1
# CONFIG_BSP_BUTTON_1_TYPE_GPIO=y
# CONFIG_BSP_BUTTON_1_GPIO=0
# CONFIG_BSP_BUTTON_1_LEVEL=0
# CONFIG_BSP_LEDS_NUM=0
# CONFIG_BUTTON_PERIOD_TIME_MS=20
# CONFIG_BUTTON_LONG_PRESS_TIME_MS=5000

# --- Debug --------------------------------------------------------------
CONFIG_ESP32_ENABLE_COREDUMP_TO_FLASH=y
CONFIG_ESP32_COREDUMP_DATA_FORMAT_ELF=y
```
